## zephyr/subsys/Kconfig
```kconfig
# Copyright (c) 2020 Legrand North America, LLC.
# SPDX-License-Identifier: MIT

# Kconfig - Subsystem configuration options

comment "BACnet Subsystems"

config BSC_WEBSOCKET_CLIENT
    bool "BSC_WEBSOCKET_CLIENT"
    default n
    select WEBSOCKET_CLIENT
    select NET_CONTEXT_SNDTIMEO
    select TLS_CREDENTIALS
    help
      This option enables client of BACnet websocket protocol

config BSC_WEBSOCKET_SERVER
    bool "BSC_WEBSOCKET_SERVER"
    default n
    #select WEBSOCKET_CLIENT
    #select NET_CONTEXT_SNDTIMEO
    select CIVETWEB
    select TLS_CREDENTIALS
    help
      This option enables server of BACnet websocket protocol

rsource "object/Kconfig"
rsource "server/Kconfig"
```
